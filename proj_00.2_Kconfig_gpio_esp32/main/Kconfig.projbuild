## proj_00.2_Kconfig_gpio_esp32/main/Kconfig.projbuild
```kconfig
menu "Example Blink Led"

   config BLINK_GPIO
    int "Blink GPIO number"
    range 0 10
    default 5
    help
        GPIO number (I0xx) to blink on and off
        Some GPIOs are used for other purposes (ADC, flash connections)
        35 - 39 input only - so cannot be used as outputs.

    config wifi_ssid
        string "WiFi SSID"
        default "rede-teste"
        help
            WiFi SSID to connect to.

    config wifi_password
        string "WiFi password"
        default "12345678"
        help 
            WiFi password to connect to.
    
endmenu
```

## proj_00.6_Kconfig_projectbuild/main/Kconfig.projbuild
```kconfig
menu "Configuracoes do Projeto Customizado"

config OPCAO_BOOLEANA
    bool "Habilitar funcionalidade X"
    default n
    help
      Isso habilita ou desabilita uma funcionalidade de exemplo no codigo.

config VALOR_INTEIRO
    int "Valor para a funcionalidade Y"
    default 10
    range 0 100
    help
      Define um valor inteiro para a funcionalidade Y, entre 0 e 100.

endmenu
```
